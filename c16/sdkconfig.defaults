## c16/sdkconfig.defaults
```kconfig
CONFIG_ESP32_REV_MIN_1=y
CONFIG_ESP32_REV_MIN=1
CONFIG_ESP_TASK_WDT=n
CONFIG_ESP_CONSOLE_UART_DEFAULT=y
CONFIG_ESP_CONSOLE_UART_NUM=0
CONFIG_ESP_CONSOLE_UART_BAUDRATE=115200
CONFIG_FREERTOS_HZ=1000
CONFIG_MAIN_TASK_STACK_SIZE=8192
CONFIG_ESP_MAIN_TASK_STACK_SIZE=8192
CONFIG_ESP32_WIFI_STATIC_RX_BUFFER_NUM=16
CONFIG_ESP32_WIFI_DYNAMIC_RX_BUFFER_NUM=32
CONFIG_ESP32_WIFI_TX_BUFFER_TYPE=1
CONFIG_ESP32_WIFI_DYNAMIC_TX_BUFFER_NUM=32
CONFIG_ESP32_WIFI_AMPDU_TX_ENABLED=y
CONFIG_ESP32_WIFI_AMPDU_RX_ENABLED=y
CONFIG_PARTITION_TABLE_CUSTOM=y
CONFIG_PARTITION_TABLE_CUSTOM_FILENAME="partitions.csv"
CONFIG_PARTITION_TABLE_CUSTOM_APP_BIN_OFFSET=0x10000
CONFIG_PARTITION_TABLE_FILENAME="partitions.csv"
CONFIG_ESPTOOLPY_FLASHSIZE_4MB=y
CONFIG_ESPTOOLPY_FLASHSIZE=4MB
CONFIG_ESPTOOLPY_FLASHMODE_DIO=y
CONFIG_ESPTOOLPY_FLASHFREQ_40M=y
CONFIG_ESP_HTTPS_OTA_INSECURE=y
CONFIG_HTTPD_MAX_URI_LEN=512
CONFIG_HTTPD_MAX_REQ_HDR_LEN=1024
CONFIG_HTTPD_MAX_REQ_BODY_LEN=16384
CONFIG_ESP32_PHY_MAX_WIFI_TX_POWER=20
CONFIG_ESP32_PHY_MAX_TX_POWER=20
CONFIG_BOOTLOADER_LOG_LEVEL_INFO=y
CONFIG_LOG_DEFAULT_LEVEL_INFO=y
CONFIG_ESP32_EFUSE_CUSTOM_MAC=n
CONFIG_ESP32_APP_TRACE_ENABLE=n
CONFIG_ESP32_XTAL_FREQ_40=y
CONFIG_ESP32_XTAL_FREQ=40
CONFIG_ESP32_RTC_CLK_SRC_INT_RC=y
CONFIG_ESP32_RTC_CLK_CAL_CYCLES=1024
CONFIG_FREERTOS_MAX_PRIORITIES=25
CONFIG_FREERTOS_HZ=1000
CONFIG_LWIP_MAX_SOCKETS=10
CONFIG_LWIP_SO_REUSE=y
CONFIG_LWIP_SO_RCVBUF=y
CONFIG_LWIP_SO_LINGER=y
CONFIG_LWIP_TCPIP_RECVMBOX_SIZE=32
CONFIG_LWIP_ACCEPT_RECVMBOX_SIZE=6
CONFIG_LWIP_TCP_MSS=1440
CONFIG_LWIP_TCP_SND_BUF_DEFAULT=5760
CONFIG_LWIP_TCP_WND_DEFAULT=5760
CONFIG_LWIP_TCP_QUEUE_OOSEQ=y
CONFIG_LWIP_TCP_OVERSIZE_MSS=y
CONFIG_LWIP_TCP_TMR_INTERVAL=250
CONFIG_ESP_TLS_SERVER_SESSION_TICKETS=y
CONFIG_HTTPD_MAX_OPEN_SOCKETS=7
CONFIG_HTTPD_MAX_REQ_HDR_LEN=1024
CONFIG_HTTPD_MAX_REQ_BODY_LEN=16384
CONFIG_HTTPD_MAX_URI_LEN=512
CONFIG_HTTPD_ERR_RESP_NO_DELAY=y
CONFIG_HTTPD_PURGE_BUF_LEN=32
CONFIG_FATFS_PER_FILE_CACHE=y
CONFIG_FATFS_USE_LFN=y
CONFIG_FATFS_CODEPAGE_UTF8=y
CONFIG_FATFS_CODEPAGE=437
CONFIG_FATFS_MAX_LFN=255
CONFIG_FATFS_FS_LOCK=0
CONFIG_FATFS_TIMEOUT_MS=10000
CONFIG_FATFS_PER_FILE_CACHE_SIZE=4096
CONFIG_FATFS_ALLOC_PREFER_EXTRAM=n
CONFIG_SPI_DMA_CHAN_1=y
CONFIG_SPI_DMA_CHAN=1
CONFIG_SPI_MASTER_ISR_IN_IRAM=y
CONFIG_SPI_MASTER_IN_IRAM=n
CONFIG_SPI_MASTER_DUAL=y
CONFIG_SPI_MASTER_QUAD=y
CONFIG_SPI_MASTER_ISR_CORE_AFFINITY_NO_AFFINITY=y
CONFIG_SDMMC_HOST_DEFAULT=y
CONFIG_SDMMC_HOST_SLOT_0=y
CONFIG_SDMMC_HOST_SLOT=0
CONFIG_SDMMC_MAX_FREQ=20
CONFIG_SDMMC_SAMPLE_CARD_DELAY=y
CONFIG_SDMMC_ENABLE_18V_OCR=y
CONFIG_SDMMC_CMD_DELAY_USEC=0
CONFIG_SDMMC_IOMUX_PIN_NUM_CLK=6
CONFIG_SDMMC_IOMUX_PIN_NUM_CMD=11
CONFIG_SDMMC_IOMUX_PIN_NUM_D0=7
CONFIG_SDMMC_IOMUX_PIN_NUM_D1=8
CONFIG_SDMMC_IOMUX_PIN_NUM_D2=9
CONFIG_SDMMC_IOMUX_PIN_NUM_D3=10
CONFIG_SDMMC_IOMUX_PIN_NUM_D4=16
CONFIG_SDMMC_IOMUX_PIN_NUM_D5=17
CONFIG_SDMMC_IOMUX_PIN_NUM_D6=5
CONFIG_SDMMC_IOMUX_PIN_NUM_D7=18
CONFIG_SPI_SLAVE=y
CONFIG_SPI_MASTER=y
CONFIG_SDMMC_HOST_DEFAULT=y
CONFIG_FATFS_VOLUME_COUNT=2
CONFIG_FATFS_LFN_STACK=y
CONFIG_SPI_SLAVE_GPIO_HANDSHAKE=y
CONFIG_SPI_SLAVE_DMA=y
CONFIG_SPI_SLAVE_ISR_IN_IRAM=n
CONFIG_SDIO_SLAVE_SUPPORT=n
CONFIG_GATTC=y
CONFIG_GATTS=y
CONFIG_BLE_ESP_GATTS=y
CONFIG_BLE_ESP_GATTC=y
CONFIG_VFS_SUPPORT_IO=y
CONFIG_VFS_SUPPORT_DIR=y
CONFIG_VFS_SUPPORT_SELECT=y
CONFIG_NEWLIB_STDOUT_LINE_ENDING_CRLF=y
CONFIG_NEWLIB_STDIN_LINE_ENDING_CR=y
```
